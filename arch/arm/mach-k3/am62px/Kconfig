## arch/arm/mach-k3/am62px/Kconfig
```kconfig
# SPDX-License-Identifier: GPL-2.0+
#
# Copyright (C) 2024 Texas Instruments Incorporated - https://www.ti.com/
#

if SOC_K3_AM62P5

choice
	prompt "TI K3 AM62Px based boards"
	optional

config TARGET_AM62P5_A53_EVM
	bool "TI K3 based AM62P5 EVM running on A53"
	select ARM64
	select BINMAN
	select OF_SYSTEM_SETUP
	imply TI_COMMON_CMD_OPTIONS

config TARGET_AM62P5_R5_EVM
	bool "TI K3 based AM62P5 EVM running on R5"
	select CPU_V7R
	select SYS_THUMB_BUILD
	select K3_LOAD_SYSFW
	select RAM
	select SPL_RAM
	select K3_DDRSS
	select BINMAN
	imply SYS_K3_SPL_ATF

config TARGET_AM62P5_A53_VAR_SOM
	bool "Varisite VAR-SOM-AM62P running on A53"
	select ARM64
	select BINMAN
	select OF_SYSTEM_SETUP
	imply TI_COMMON_CMD_OPTIONS

config TARGET_AM62P5_R5_VAR_SOM
	bool "Varisite VAR-SOM-AM62P running on R5"
	select CPU_V7R
	select SYS_THUMB_BUILD
	select K3_LOAD_SYSFW
	select RAM
	select SPL_RAM
	select K3_DDRSS
	select BINMAN
	imply SYS_K3_SPL_ATF

endchoice

source "board/ti/am62px/Kconfig"
source "board/variscite/am62px_var_som/Kconfig"

endif
```

## board/variscite/am62px_var_som/Kconfig
```kconfig
# SPDX-License-Identifier: GPL-2.0+
#
# Copyright (C) 2023 Texas Instruments Incorporated - https://www.ti.com/
# Copyright 2025 Variscite Ltd. - https://www.variscite.com/
#

if TARGET_AM62P5_R5_VAR_SOM || TARGET_AM62P5_A53_VAR_SOM

config SYS_BOARD
       default "am62px_var_som"

config SYS_VENDOR
       default "variscite"

config SYS_CONFIG_NAME
       default "am62px_var_som"

source "board/ti/common/Kconfig"

endif

if TARGET_AM62P5_R5_VAR_SOM

config SPL_LDSCRIPT
	default "arch/arm/mach-omap2/u-boot-spl.lds"

endif
```
